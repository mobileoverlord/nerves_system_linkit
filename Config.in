## package/mtk-linkit/Config.in
```kconfig
config BR2_PACKAGE_MTK_LINKIT
	bool "mtk-linkit"
	help
	  This is a collection of utilities from OpenWRT for use on the
	  LinkIt Smart 7688.

	  https://github.com/MediaTek-Labs/linkit-smart-7688-feed/tree/master/mtk-linkit/
```

## package/mtk-sdk-wifi/Config.in
```kconfig
config BR2_PACKAGE_MTK_SDK_WIFI
	bool "mtk-sdk-wifi"
	depends on BR2_LINUX_KERNEL
	select BR2_LINUX_NEEDS_MODULES # not using kernel-module infra
	help
	  This project contains the LinkIt Smart 7688's proprietary Wi-Fi drivers
	  as included in OpenWRT. Modifications were made to pull them into Nerves.

	  https://github.com/MediaTek-Labs/linkit-smart-7688-feed/tree/master/mtk-sdk-wifi
```

## package/openwrt-compat-wireless/Config.in
```kconfig
comment "openwrt-compat-wireless needs a Linux kernel to be built"
	depends on !BR2_LINUX_KERNEL

config BR2_PACKAGE_OPENWRT_COMPAT_WIRELESS
	bool "openwrt-compat-wireless"
	depends on BR2_LINUX_KERNEL
	help
	  This is a very special version of linux-backports that was found in
	  OpenWRT. It is needed to build the mt76 wifi drivers.

if BR2_PACKAGE_OPENWRT_COMPAT_WIRELESS

choice
	prompt "Linux kernel driver backports configuration"
	default BR2_PACKAGE_OPENWRT_COMPAT_WIRELESS_USE_DEFCONFIG

config BR2_PACKAGE_OPENWRT_COMPAT_WIRELESS_USE_DEFCONFIG
	bool "Using an in-tree defconfig file"

config BR2_PACKAGE_OPENWRT_COMPAT_WIRELESS_USE_CUSTOM_CONFIG
	bool "Using a custom (def)config file"

endchoice

config BR2_PACKAGE_OPENWRT_COMPAT_WIRELESS_DEFCONFIG
	string "Defconfig name"
	depends on BR2_PACKAGE_OPENWRT_COMPAT_WIRELESS_USE_DEFCONFIG
	help
	  Name of the backports defconfig file to use, without the
	  leading defconfig-. The defconfig is located in defconfigs/
	  directory in the backports tree.

config BR2_PACKAGE_OPENWRT_COMPAT_WIRELESS_CUSTOM_CONFIG_FILE
	string "Configuration file path"
	depends on BR2_PACKAGE_OPENWRT_COMPAT_WIRELESS_USE_CUSTOM_CONFIG
	help
	  Path to the backports configuration file

	  Note: this can be a defconfig file or a complete .config file,
	  which can later be saved back with make linux-update-(def)config.

config BR2_PACKAGE_OPENWRT_COMPAT_WIRELESS_CONFIG_FRAGMENT_FILES
	string "Additional configuration fragment files"
	help
	  A space-separated list of configuration fragment files, that
	  will be merged to the main openwrt-compat-wireless configuration file.

endif # BR2_PACKAGE_OPENWRT_COMPAT_WIRELESS
```

## package/openwrt-utils/Config.in.host
```kconfig
config BR2_PACKAGE_HOST_OPENWRT_UTILS
	bool "host openwrt-utils"
	help
	  This is a collection of utilities from OpenWRT required for creating
	  firmware images with their kernel patches.

	  http://openwrt.com/
```

## package/swconfig/Config.in
```kconfig
config BR2_PACKAGE_SWCONFIG
	bool "swconfig"
	help
	  The program swconfig allows you to configure configurable
	  Ethernet network switches.

	  https://wiki.openwrt.org/doc/techref/swconfig
```
